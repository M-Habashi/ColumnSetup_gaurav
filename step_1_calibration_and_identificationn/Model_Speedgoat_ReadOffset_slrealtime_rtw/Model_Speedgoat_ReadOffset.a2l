/******************************************************************************
* ASAP2 file: Model_Speedgoat_ReadOffset.a2l
* Academic License - for use in teaching, academic research, and meeting
* course requirements at degree granting institutions only. Not for
* government, commercial, or other organizational use.
* Code generation for model "Model_Speedgoat_ReadOffset".
* Model version : 1.23
* Simulink Coder version : 10.2 R2020b
* C source code generated on : Sun May 31 21:14:19 2026
* Target selection: slrealtime.tlc
* Embedded hardware selection: Intel->x86-64 (Linux 64)
* Code generation objectives: Unspecified
* Validation result: Not run
* (add additional file header information here)
******************************************************************************/ ASAP2_VERSION 1 71
/begin PROJECT ProjectName "Project Comment Goes Here"
/begin HEADER "Header Comments go here" /end HEADER
/begin MODULE ModuleName "Module Comment Goes Here"
/begin IF_DATA XCP
 /begin PROTOCOL_LAYER 0x0100 0x03E8 0x00C8 0x0000 0x0000 0x0000 0x0000 0x0000 0xFC 0x0578 BYTE_ORDER_MSB_LAST ADDRESS_GRANULARITY_BYTE OPTIONAL_CMD ALLOC_ODT_ENTRY OPTIONAL_CMD ALLOC_ODT OPTIONAL_CMD ALLOC_DAQ OPTIONAL_CMD FREE_DAQ OPTIONAL_CMD GET_DAQ_RESOLUTION_INFO OPTIONAL_CMD GET_DAQ_PROCESSOR_INFO OPTIONAL_CMD START_STOP_SYNCH OPTIONAL_CMD START_STOP_DAQ_LIST OPTIONAL_CMD SET_DAQ_LIST_MODE OPTIONAL_CMD WRITE_DAQ OPTIONAL_CMD SET_DAQ_PTR OPTIONAL_CMD GET_CAL_PAGE OPTIONAL_CMD SET_CAL_PAGE OPTIONAL_CMD COPY_CAL_PAGE OPTIONAL_CMD SHORT_DOWNLOAD OPTIONAL_CMD DOWNLOAD_MAX OPTIONAL_CMD DOWNLOAD OPTIONAL_CMD SHORT_UPLOAD OPTIONAL_CMD UPLOAD OPTIONAL_CMD SET_MTA /end PROTOCOL_LAYER
 /begin DAQ DYNAMIC 0x0000 0x0080 0x00 OPTIMISATION_TYPE_DEFAULT ADDRESS_EXTENSION_FREE IDENTIFICATION_FIELD_TYPE_RELATIVE_WORD_ALIGNED GRANULARITY_ODT_ENTRY_SIZE_DAQ_BYTE 0xFF OVERLOAD_INDICATION_PID PRESCALER_SUPPORTED /begin STIM GRANULARITY_ODT_ENTRY_SIZE_STIM_BYTE 0xFF /end STIM /begin TIMESTAMP_SUPPORTED 0x0001 SIZE_DWORD UNIT_1US TIMESTAMP_FIXED /end TIMESTAMP_SUPPORTED /begin EVENT "490 us" "490 us" 0x0000 DAQ 0xFF 0x31 0x04 0x00 /end EVENT /end DAQ
 /begin XCP_ON_UDP_IP 0x0100 0x15B3 ADDRESS "192.168.7.5" /end XCP_ON_UDP_IP
/end IF_DATA
/begin MOD_PAR "MOD PAR Comment Goes Here"
 /begin MEMORY_SEGMENT Model_Speedgoat_ReadOf_cal_impl "Model_Speedgoat_ReadOf_cal_impl" DATA FLASH INTERN 0x0020B020 0x168 -1 -1 -1 -1 -1
  /begin IF_DATA XCP
   /begin SEGMENT 0x00 0x02 0x00 0x00 0x00
    /begin PAGE 0x00 ECU_ACCESS_DONT_CARE XCP_READ_ACCESS_DONT_CARE XCP_WRITE_ACCESS_NOT_ALLOWED /end PAGE
    /begin PAGE 0x01 ECU_ACCESS_DONT_CARE XCP_READ_ACCESS_DONT_CARE XCP_WRITE_ACCESS_DONT_CARE /end PAGE
   /end SEGMENT
  /end IF_DATA
 /end MEMORY_SEGMENT
/end MOD_PAR
/begin MOD_COMMON "Mod Common Comment Here" BYTE_ORDER MSB_LAST /end MOD_COMMON
/begin CHARACTERISTIC Model_Speedgoat_ReadOf_cal_impl.Analoginput_P1 "" VALUE 0x0020B108 Scalar_FLOAT64_IEEE 0 Model_Speedgoat_ReadOffset_CM_double -1.7E+308 1.7E+308 /end CHARACTERISTIC
/begin CHARACTERISTIC Model_Speedgoat_ReadOf_cal_impl.Analoginput_P2 "" VALUE 0x0020B120 Scalar_FLOAT64_IEEE 0 Model_Speedgoat_ReadOffset_CM_double -1.7E+308 1.7E+308 /end CHARACTERISTIC
/begin CHARACTERISTIC Model_Speedgoat_ReadOf_cal_impl.Analoginput_P3 "" VALUE 0x0020B138 Scalar_FLOAT64_IEEE 0 Model_Speedgoat_ReadOffset_CM_double -1.7E+308 1.7E+308 /end CHARACTERISTIC
/begin CHARACTERISTIC Model_Speedgoat_ReadOf_cal_impl.Analoginput_P4 "" VALUE 0x0020B150 Scalar_FLOAT64_IEEE 0 Model_Speedgoat_ReadOffset_CM_double -1.7E+308 1.7E+308 /end CHARACTERISTIC
/begin CHARACTERISTIC Model_Speedgoat_ReadOf_cal_impl.Analoginput_P5 "" VALUE 0x0020B168 Scalar_FLOAT64_IEEE 0 Model_Speedgoat_ReadOffset_CM_double -1.7E+308 1.7E+308 /end CHARACTERISTIC
/begin CHARACTERISTIC Model_Speedgoat_ReadOf_cal_impl.Analoginput_P6 "" VALUE 0x0020B180 Scalar_FLOAT64_IEEE 0 Model_Speedgoat_ReadOffset_CM_double -1.7E+308 1.7E+308 /end CHARACTERISTIC
/begin CHARACTERISTIC Model_Speedgoat_ReadOf_cal_impl.Setup_P1 "" VALUE 0x0020B030 Scalar_FLOAT64_IEEE 0 Model_Speedgoat_ReadOffset_CM_double -1.7E+308 1.7E+308 /end CHARACTERISTIC
/begin CHARACTERISTIC Model_Speedgoat_ReadOf_cal_impl.Setup_P2 "" VALUE 0x0020B048 Scalar_FLOAT64_IEEE 0 Model_Speedgoat_ReadOffset_CM_double -1.7E+308 1.7E+308 /end CHARACTERISTIC
/begin CHARACTERISTIC Model_Speedgoat_ReadOf_cal_impl.Setup_P3 "" VALUE 0x0020B060 Scalar_FLOAT64_IEEE 0 Model_Speedgoat_ReadOffset_CM_double -1.7E+308 1.7E+308 /end CHARACTERISTIC
/begin CHARACTERISTIC Model_Speedgoat_ReadOf_cal_impl.Setup_P4 "" VALUE 0x0020B078 Scalar_FLOAT64_IEEE 0 Model_Speedgoat_ReadOffset_CM_double -1.7E+308 1.7E+308 /end CHARACTERISTIC
/begin CHARACTERISTIC Model_Speedgoat_ReadOf_cal_impl.Setup_P5 "" VALUE 0x0020B090 Scalar_FLOAT64_IEEE 0 Model_Speedgoat_ReadOffset_CM_double -1.7E+308 1.7E+308 /end CHARACTERISTIC
/begin CHARACTERISTIC Model_Speedgoat_ReadOf_cal_impl.Setup_P6 "" VALUE 0x0020B0A8 Scalar_FLOAT64_IEEE 0 Model_Speedgoat_ReadOffset_CM_double -1.7E+308 1.7E+308 /end CHARACTERISTIC
/begin CHARACTERISTIC Model_Speedgoat_ReadOf_cal_impl.Setup_P7 "" VALUE 0x0020B0C0 Scalar_FLOAT64_IEEE 0 Model_Speedgoat_ReadOffset_CM_double -1.7E+308 1.7E+308 /end CHARACTERISTIC
/begin CHARACTERISTIC Model_Speedgoat_ReadOf_cal_impl.Setup_P8 "" VALUE 0x0020B0D8 Scalar_FLOAT64_IEEE 0 Model_Speedgoat_ReadOffset_CM_double -1.7E+308 1.7E+308 /end CHARACTERISTIC
/begin CHARACTERISTIC Model_Speedgoat_ReadOf_cal_impl.Setup_P9 "" VALUE 0x0020B0F0 Scalar_FLOAT64_IEEE 0 Model_Speedgoat_ReadOffset_CM_double -1.7E+308 1.7E+308 /end CHARACTERISTIC
/begin MEASUREMENT Model_Speedgoat_ReadOffset_B.Analoginput "" FLOAT64_IEEE Model_Speedgoat_ReadOffset_CM_double 0 0 -1.7E+308 1.7E+308 LAYOUT COLUMN_DIR MATRIX_DIM 18 ECU_ADDRESS 0x0020C600 /end MEASUREMENT
/begin COMPU_METHOD Model_Speedgoat_ReadOffset_CM_double "" IDENTICAL "%15.10" "" /end COMPU_METHOD
/begin RECORD_LAYOUT Scalar_FLOAT64_IEEE FNC_VALUES 1 FLOAT64_IEEE COLUMN_DIR DIRECT /end RECORD_LAYOUT
/begin GROUP Model_Speedgoat_ReadOffset "Model_Speedgoat_ReadOffset" ROOT /end GROUP
/end MODULE
/end PROJECT
