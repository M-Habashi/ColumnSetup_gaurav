/******************************************************************************
* ASAP2 file: model_ColumnSetup_00.a2l
* Academic License - for use in teaching, academic research, and meeting
* course requirements at degree granting institutions only. Not for
* government, commercial, or other organizational use.
* Code generation for model "model_ColumnSetup_00".
* Model version : 16.227
* Simulink Coder version : 10.2 R2020b
* C source code generated on : Fri Jun 05 16:55:19 2026
* Target selection: slrealtime.tlc
* Embedded hardware selection: Intel->x86-64 (Linux 64)
* Code generation objectives: Unspecified
* Validation result: Not run
* (add additional file header information here)
******************************************************************************/ ASAP2_VERSION 1 71
/begin PROJECT ProjectName "Project Comment Goes Here"
/begin HEADER "Header Comments go here" /end HEADER
/begin MODULE ModuleName "Module Comment Goes Here"
/begin IF_DATA XCP
 /begin PROTOCOL_LAYER 0x0100 0x03E8 0x00C8 0x0000 0x0000 0x0000 0x0000 0x0000 0xFC 0x0578 BYTE_ORDER_MSB_LAST ADDRESS_GRANULARITY_BYTE OPTIONAL_CMD ALLOC_ODT_ENTRY OPTIONAL_CMD ALLOC_ODT OPTIONAL_CMD ALLOC_DAQ OPTIONAL_CMD FREE_DAQ OPTIONAL_CMD GET_DAQ_RESOLUTION_INFO OPTIONAL_CMD GET_DAQ_PROCESSOR_INFO OPTIONAL_CMD START_STOP_SYNCH OPTIONAL_CMD START_STOP_DAQ_LIST OPTIONAL_CMD SET_DAQ_LIST_MODE OPTIONAL_CMD WRITE_DAQ OPTIONAL_CMD SET_DAQ_PTR OPTIONAL_CMD GET_CAL_PAGE OPTIONAL_CMD SET_CAL_PAGE OPTIONAL_CMD COPY_CAL_PAGE OPTIONAL_CMD SHORT_DOWNLOAD OPTIONAL_CMD DOWNLOAD_MAX OPTIONAL_CMD DOWNLOAD OPTIONAL_CMD SHORT_UPLOAD OPTIONAL_CMD UPLOAD OPTIONAL_CMD SET_MTA /end PROTOCOL_LAYER
 /begin DAQ DYNAMIC 0x0000 0x0080 0x00 OPTIMISATION_TYPE_DEFAULT ADDRESS_EXTENSION_FREE IDENTIFICATION_FIELD_TYPE_RELATIVE_WORD_ALIGNED GRANULARITY_ODT_ENTRY_SIZE_DAQ_BYTE 0xFF OVERLOAD_INDICATION_PID PRESCALER_SUPPORTED /begin STIM GRANULARITY_ODT_ENTRY_SIZE_STIM_BYTE 0xFF /end STIM /begin TIMESTAMP_SUPPORTED 0x0001 SIZE_DWORD UNIT_1US TIMESTAMP_FIXED /end TIMESTAMP_SUPPORTED /begin EVENT "490 us" "490 us" 0x0000 DAQ 0xFF 0x31 0x04 0x00 /end EVENT /end DAQ
 /begin XCP_ON_UDP_IP 0x0100 0x15B3 ADDRESS "192.168.7.5" /end XCP_ON_UDP_IP
/end IF_DATA
/begin MOD_PAR "MOD PAR Comment Goes Here"
 /begin MEMORY_SEGMENT model_ColumnSetup_00_cal_impl "model_ColumnSetup_00_cal_impl" DATA FLASH INTERN 0x0020E020 0x960 -1 -1 -1 -1 -1
  /begin IF_DATA XCP
   /begin SEGMENT 0x00 0x02 0x00 0x00 0x00
    /begin PAGE 0x00 ECU_ACCESS_DONT_CARE XCP_READ_ACCESS_DONT_CARE XCP_WRITE_ACCESS_NOT_ALLOWED /end PAGE
    /begin PAGE 0x01 ECU_ACCESS_DONT_CARE XCP_READ_ACCESS_DONT_CARE XCP_WRITE_ACCESS_DONT_CARE /end PAGE
   /end SEGMENT
  /end IF_DATA
 /end MEMORY_SEGMENT
/end MOD_PAR
/begin MOD_COMMON "Mod Common Comment Here" BYTE_ORDER MSB_LAST /end MOD_COMMON
/begin CHARACTERISTIC dd_pause_enable "Dashboard flag for pausing time-history and sine command generation." VALUE 0x00211848 Scalar_FLOAT64_IEEE 0 model_ColumnSetup_00_CM_double -1.7E+308 1.7E+308 /end CHARACTERISTIC
/begin CHARACTERISTIC model_ColumnSetup_00_P.command_channel_selector "" VAL_BLK 0x0020E9A0 Scalar_FLOAT64_IEEE 0 model_ColumnSetup_00_CM_double -1.7E+308 1.7E+308 MATRIX_DIM 1 7 /end CHARACTERISTIC
/begin CHARACTERISTIC model_ColumnSetup_00_P.correction_gain "" VALUE 0x0020E9D8 Scalar_FLOAT64_IEEE 0 model_ColumnSetup_00_CM_double -1.7E+308 1.7E+308 /end CHARACTERISTIC
/begin CHARACTERISTIC model_ColumnSetup_00_P.dt "" VALUE 0x0020E9E0 Scalar_FLOAT64_IEEE 0 model_ColumnSetup_00_CM_double -1.7E+308 1.7E+308 /end CHARACTERISTIC
/begin CHARACTERISTIC model_ColumnSetup_00_P.f_final "" VALUE 0x0020E9E8 Scalar_FLOAT64_IEEE 0 model_ColumnSetup_00_CM_double -1.7E+308 1.7E+308 /end CHARACTERISTIC
/begin CHARACTERISTIC model_ColumnSetup_00_P.f_init "" VALUE 0x0020E9F0 Scalar_FLOAT64_IEEE 0 model_ColumnSetup_00_CM_double -1.7E+308 1.7E+308 /end CHARACTERISTIC
/begin CHARACTERISTIC model_ColumnSetup_00_P.sat_limit "" VALUE 0x0020E9F8 Scalar_FLOAT64_IEEE 0 model_ColumnSetup_00_CM_double -1.7E+308 1.7E+308 /end CHARACTERISTIC
/begin CHARACTERISTIC model_ColumnSetup_00_P.t_ending "" VALUE 0x0020EA00 Scalar_FLOAT64_IEEE 0 model_ColumnSetup_00_CM_double -1.7E+308 1.7E+308 /end CHARACTERISTIC
/begin CHARACTERISTIC model_ColumnSetup_00_P.tend_chirp "" VALUE 0x0020EA08 Scalar_FLOAT64_IEEE 0 model_ColumnSetup_00_CM_double -1.7E+308 1.7E+308 /end CHARACTERISTIC
/begin CHARACTERISTIC model_ColumnSetup_00_P.v2a_gain "" VALUE 0x0020EA10 Scalar_FLOAT64_IEEE 0 model_ColumnSetup_00_CM_double -1.7E+308 1.7E+308 /end CHARACTERISTIC
/begin CHARACTERISTIC model_ColumnSetup_00_P.v2d_gain "" VALUE 0x0020EA18 Scalar_FLOAT64_IEEE 0 model_ColumnSetup_00_CM_double -1.7E+308 1.7E+308 /end CHARACTERISTIC
/begin CHARACTERISTIC model_ColumnSetup_00_P.v2f_gain "" VALUE 0x0020EA20 Scalar_FLOAT64_IEEE 0 model_ColumnSetup_00_CM_double -1.7E+308 1.7E+308 /end CHARACTERISTIC
/begin CHARACTERISTIC model_ColumnSetup_00_P.zero_alpha "" VALUE 0x0020EA28 Scalar_FLOAT64_IEEE 0 model_ColumnSetup_00_CM_double -1.7E+308 1.7E+308 /end CHARACTERISTIC
/begin CHARACTERISTIC model_ColumnSetup_00_cal_impl.AnalogOutput_P1 "" VALUE 0x0020E730 Scalar_FLOAT64_IEEE 0 model_ColumnSetup_00_CM_double -1.7E+308 1.7E+308 /end CHARACTERISTIC
/begin CHARACTERISTIC model_ColumnSetup_00_cal_impl.AnalogOutput_P2 "" VAL_BLK 0x0020E748 Scalar_FLOAT64_IEEE 0 model_ColumnSetup_00_CM_double -1.7E+308 1.7E+308 MATRIX_DIM 7 1 /end CHARACTERISTIC
/begin CHARACTERISTIC model_ColumnSetup_00_cal_impl.AnalogOutput_P3 "" VAL_BLK 0x0020E790 Scalar_FLOAT64_IEEE 0 model_ColumnSetup_00_CM_double -1.7E+308 1.7E+308 MATRIX_DIM 7 1 /end CHARACTERISTIC
/begin CHARACTERISTIC model_ColumnSetup_00_cal_impl.AnalogOutput_P4 "" VALUE 0x0020E7D8 Scalar_FLOAT64_IEEE 0 model_ColumnSetup_00_CM_double -1.7E+308 1.7E+308 /end CHARACTERISTIC
/begin CHARACTERISTIC model_ColumnSetup_00_cal_impl.AnalogOutput_P5 "" VALUE 0x0020E7F0 Scalar_FLOAT64_IEEE 0 model_ColumnSetup_00_CM_double -1.7E+308 1.7E+308 /end CHARACTERISTIC
/begin CHARACTERISTIC model_ColumnSetup_00_cal_impl.AnalogOutput_P6 "" VALUE 0x0020E808 Scalar_FLOAT64_IEEE 0 model_ColumnSetup_00_CM_double -1.7E+308 1.7E+308 /end CHARACTERISTIC
/begin CHARACTERISTIC model_ColumnSetup_00_cal_impl.Analoginput_P1 "" VALUE 0x0020E8F8 Scalar_FLOAT64_IEEE 0 model_ColumnSetup_00_CM_double -1.7E+308 1.7E+308 /end CHARACTERISTIC
/begin CHARACTERISTIC model_ColumnSetup_00_cal_impl.Analoginput_P2 "" VALUE 0x0020E910 Scalar_FLOAT64_IEEE 0 model_ColumnSetup_00_CM_double -1.7E+308 1.7E+308 /end CHARACTERISTIC
/begin CHARACTERISTIC model_ColumnSetup_00_cal_impl.Analoginput_P3 "" VALUE 0x0020E928 Scalar_FLOAT64_IEEE 0 model_ColumnSetup_00_CM_double -1.7E+308 1.7E+308 /end CHARACTERISTIC
/begin CHARACTERISTIC model_ColumnSetup_00_cal_impl.Analoginput_P4 "" VALUE 0x0020E940 Scalar_FLOAT64_IEEE 0 model_ColumnSetup_00_CM_double -1.7E+308 1.7E+308 /end CHARACTERISTIC
/begin CHARACTERISTIC model_ColumnSetup_00_cal_impl.Analoginput_P5 "" VALUE 0x0020E958 Scalar_FLOAT64_IEEE 0 model_ColumnSetup_00_CM_double -1.7E+308 1.7E+308 /end CHARACTERISTIC
/begin CHARACTERISTIC model_ColumnSetup_00_cal_impl.Analoginput_P6 "" VALUE 0x0020E970 Scalar_FLOAT64_IEEE 0 model_ColumnSetup_00_CM_double -1.7E+308 1.7E+308 /end CHARACTERISTIC
/begin CHARACTERISTIC model_ColumnSetup_00_cal_impl.BLWNPauseGate_Threshold "" VALUE 0x0020E060 Scalar_FLOAT64_IEEE 0 model_ColumnSetup_00_CM_double -1.7E+308 1.7E+308 /end CHARACTERISTIC
/begin CHARACTERISTIC model_ColumnSetup_00_cal_impl.BLWNPauseZero_Value "" VALUE 0x0020E050 Scalar_FLOAT64_IEEE 0 model_ColumnSetup_00_CM_double -1.7E+308 1.7E+308 /end CHARACTERISTIC
/begin CHARACTERISTIC model_ColumnSetup_00_cal_impl.BandLimitedWhiteNoise_Cov "" VALUE 0x0020E020 Scalar_FLOAT64_IEEE 0 model_ColumnSetup_00_CM_double -1.7E+308 1.7E+308 /end CHARACTERISTIC
/begin CHARACTERISTIC model_ColumnSetup_00_cal_impl.BandLimitedWhiteNoise_seed "" VALUE 0x0020E028 Scalar_FLOAT64_IEEE 0 model_ColumnSetup_00_CM_double -1.7E+308 1.7E+308 /end CHARACTERISTIC
/begin CHARACTERISTIC model_ColumnSetup_00_cal_impl.Constant1_Value "" VALUE 0x0020E078 Scalar_FLOAT64_IEEE 0 model_ColumnSetup_00_CM_double -1.7E+308 1.7E+308 /end CHARACTERISTIC
/begin CHARACTERISTIC model_ColumnSetup_00_cal_impl.Constant_Value "" VALUE 0x0020E2C0 Scalar_FLOAT64_IEEE 0 model_ColumnSetup_00_CM_double -1.7E+308 1.7E+308 /end CHARACTERISTIC
/begin CHARACTERISTIC model_ColumnSetup_00_cal_impl.Controllerplaceholder_Gain "" VALUE 0x0020E710 Scalar_FLOAT64_IEEE 0 model_ColumnSetup_00_CM_double -1.7E+308 1.7E+308 /end CHARACTERISTIC
/begin CHARACTERISTIC model_ColumnSetup_00_cal_impl.DigitalFilter_Coefficients "" VAL_BLK 0x0020E2F8 Scalar_FLOAT64_IEEE 0 model_ColumnSetup_00_CM_double -1.7E+308 1.7E+308 MATRIX_DIM 131 1 /end CHARACTERISTIC
/begin CHARACTERISTIC model_ColumnSetup_00_cal_impl.DigitalFilter_InitialStates "" VALUE 0x0020E2F0 Scalar_FLOAT64_IEEE 0 model_ColumnSetup_00_CM_double -1.7E+308 1.7E+308 /end CHARACTERISTIC
/begin CHARACTERISTIC model_ColumnSetup_00_cal_impl.Gain1_Gain "" VALUE 0x0020E058 Scalar_FLOAT64_IEEE 0 model_ColumnSetup_00_CM_double -1.7E+308 1.7E+308 /end CHARACTERISTIC
/begin CHARACTERISTIC model_ColumnSetup_00_cal_impl.Gain_Gain "" VALUE 0x0020E068 Scalar_FLOAT64_IEEE 0 model_ColumnSetup_00_CM_double -1.7E+308 1.7E+308 /end CHARACTERISTIC
/begin CHARACTERISTIC model_ColumnSetup_00_cal_impl.Gain_Gain_b "" VALUE 0x0020E070 Scalar_FLOAT64_IEEE 0 model_ColumnSetup_00_CM_double -1.7E+308 1.7E+308 /end CHARACTERISTIC
/begin CHARACTERISTIC model_ColumnSetup_00_cal_impl.Setup_P1 "" VALUE 0x0020E090 Scalar_FLOAT64_IEEE 0 model_ColumnSetup_00_CM_double -1.7E+308 1.7E+308 /end CHARACTERISTIC
/begin CHARACTERISTIC model_ColumnSetup_00_cal_impl.Setup_P10 "" VAL_BLK 0x0020E1F8 Scalar_FLOAT64_IEEE 0 model_ColumnSetup_00_CM_double -1.7E+308 1.7E+308 MATRIX_DIM 7 1 /end CHARACTERISTIC
/begin CHARACTERISTIC model_ColumnSetup_00_cal_impl.Setup_P11 "" VAL_BLK 0x0020E240 Scalar_FLOAT64_IEEE 0 model_ColumnSetup_00_CM_double -1.7E+308 1.7E+308 MATRIX_DIM 4 1 /end CHARACTERISTIC
/begin CHARACTERISTIC model_ColumnSetup_00_cal_impl.Setup_P12 "" VALUE 0x0020E270 Scalar_FLOAT64_IEEE 0 model_ColumnSetup_00_CM_double -1.7E+308 1.7E+308 /end CHARACTERISTIC
/begin CHARACTERISTIC model_ColumnSetup_00_cal_impl.Setup_P13 "" VALUE 0x0020E288 Scalar_FLOAT64_IEEE 0 model_ColumnSetup_00_CM_double -1.7E+308 1.7E+308 /end CHARACTERISTIC
/begin CHARACTERISTIC model_ColumnSetup_00_cal_impl.Setup_P14 "" VALUE 0x0020E2A0 Scalar_FLOAT64_IEEE 0 model_ColumnSetup_00_CM_double -1.7E+308 1.7E+308 /end CHARACTERISTIC
/begin CHARACTERISTIC model_ColumnSetup_00_cal_impl.Setup_P15 "" VALUE 0x0020E2B8 Scalar_FLOAT64_IEEE 0 model_ColumnSetup_00_CM_double -1.7E+308 1.7E+308 /end CHARACTERISTIC
/begin CHARACTERISTIC model_ColumnSetup_00_cal_impl.Setup_P1_p "" VALUE 0x0020E820 Scalar_FLOAT64_IEEE 0 model_ColumnSetup_00_CM_double -1.7E+308 1.7E+308 /end CHARACTERISTIC
/begin CHARACTERISTIC model_ColumnSetup_00_cal_impl.Setup_P2 "" VALUE 0x0020E0A8 Scalar_FLOAT64_IEEE 0 model_ColumnSetup_00_CM_double -1.7E+308 1.7E+308 /end CHARACTERISTIC
/begin CHARACTERISTIC model_ColumnSetup_00_cal_impl.Setup_P2_j "" VALUE 0x0020E838 Scalar_FLOAT64_IEEE 0 model_ColumnSetup_00_CM_double -1.7E+308 1.7E+308 /end CHARACTERISTIC
/begin CHARACTERISTIC model_ColumnSetup_00_cal_impl.Setup_P3 "" VALUE 0x0020E0C0 Scalar_FLOAT64_IEEE 0 model_ColumnSetup_00_CM_double -1.7E+308 1.7E+308 /end CHARACTERISTIC
/begin CHARACTERISTIC model_ColumnSetup_00_cal_impl.Setup_P3_h "" VALUE 0x0020E850 Scalar_FLOAT64_IEEE 0 model_ColumnSetup_00_CM_double -1.7E+308 1.7E+308 /end CHARACTERISTIC
/begin CHARACTERISTIC model_ColumnSetup_00_cal_impl.Setup_P4 "" VALUE 0x0020E0D8 Scalar_FLOAT64_IEEE 0 model_ColumnSetup_00_CM_double -1.7E+308 1.7E+308 /end CHARACTERISTIC
/begin CHARACTERISTIC model_ColumnSetup_00_cal_impl.Setup_P4_m "" VALUE 0x0020E868 Scalar_FLOAT64_IEEE 0 model_ColumnSetup_00_CM_double -1.7E+308 1.7E+308 /end CHARACTERISTIC
/begin CHARACTERISTIC model_ColumnSetup_00_cal_impl.Setup_P5 "" VAL_BLK 0x0020E0F0 Scalar_FLOAT64_IEEE 0 model_ColumnSetup_00_CM_double -1.7E+308 1.7E+308 MATRIX_DIM 7 1 /end CHARACTERISTIC
/begin CHARACTERISTIC model_ColumnSetup_00_cal_impl.Setup_P5_o "" VALUE 0x0020E880 Scalar_FLOAT64_IEEE 0 model_ColumnSetup_00_CM_double -1.7E+308 1.7E+308 /end CHARACTERISTIC
/begin CHARACTERISTIC model_ColumnSetup_00_cal_impl.Setup_P6 "" VALUE 0x0020E138 Scalar_FLOAT64_IEEE 0 model_ColumnSetup_00_CM_double -1.7E+308 1.7E+308 /end CHARACTERISTIC
/begin CHARACTERISTIC model_ColumnSetup_00_cal_impl.Setup_P6_l "" VALUE 0x0020E898 Scalar_FLOAT64_IEEE 0 model_ColumnSetup_00_CM_double -1.7E+308 1.7E+308 /end CHARACTERISTIC
/begin CHARACTERISTIC model_ColumnSetup_00_cal_impl.Setup_P7 "" VALUE 0x0020E150 Scalar_FLOAT64_IEEE 0 model_ColumnSetup_00_CM_double -1.7E+308 1.7E+308 /end CHARACTERISTIC
/begin CHARACTERISTIC model_ColumnSetup_00_cal_impl.Setup_P7_h "" VALUE 0x0020E8B0 Scalar_FLOAT64_IEEE 0 model_ColumnSetup_00_CM_double -1.7E+308 1.7E+308 /end CHARACTERISTIC
/begin CHARACTERISTIC model_ColumnSetup_00_cal_impl.Setup_P8 "" VAL_BLK 0x0020E168 Scalar_FLOAT64_IEEE 0 model_ColumnSetup_00_CM_double -1.7E+308 1.7E+308 MATRIX_DIM 7 1 /end CHARACTERISTIC
/begin CHARACTERISTIC model_ColumnSetup_00_cal_impl.Setup_P8_l "" VALUE 0x0020E8C8 Scalar_FLOAT64_IEEE 0 model_ColumnSetup_00_CM_double -1.7E+308 1.7E+308 /end CHARACTERISTIC
/begin CHARACTERISTIC model_ColumnSetup_00_cal_impl.Setup_P9 "" VAL_BLK 0x0020E1B0 Scalar_FLOAT64_IEEE 0 model_ColumnSetup_00_CM_double -1.7E+308 1.7E+308 MATRIX_DIM 7 1 /end CHARACTERISTIC
/begin CHARACTERISTIC model_ColumnSetup_00_cal_impl.Setup_P9_d "" VALUE 0x0020E8E0 Scalar_FLOAT64_IEEE 0 model_ColumnSetup_00_CM_double -1.7E+308 1.7E+308 /end CHARACTERISTIC
/begin CHARACTERISTIC model_ColumnSetup_00_cal_impl.TimeHistoryLookup_tableData "" CURVE 0x0020E030 Lookup1D_FLOAT64_IEEE 0 model_ColumnSetup_00_CM_double -1.7E+308 1.7E+308
 /begin AXIS_DESCR COM_AXIS model_ColumnSetup_00_B.sf_PausableTime.tau model_ColumnSetup_00_CM_double 2 -1.7E+308 1.7E+308 AXIS_PTS_REF model_ColumnSetup_00_cal_impl.TimeHistoryLookup_bp01Data /end AXIS_DESCR
/end CHARACTERISTIC
/begin CHARACTERISTIC model_ColumnSetup_00_cal_impl.WhiteNoise_Mean "" VALUE 0x0020E2E0 Scalar_FLOAT64_IEEE 0 model_ColumnSetup_00_CM_double -1.7E+308 1.7E+308 /end CHARACTERISTIC
/begin CHARACTERISTIC model_ColumnSetup_00_cal_impl.WhiteNoise_StdDev "" VALUE 0x0020E2E8 Scalar_FLOAT64_IEEE 0 model_ColumnSetup_00_CM_double -1.7E+308 1.7E+308 /end CHARACTERISTIC
/begin CHARACTERISTIC model_ColumnSetup_00_cal_impl.signal_offset_InitialConditio_b "" VALUE 0x0020E978 Scalar_FLOAT64_IEEE 0 model_ColumnSetup_00_CM_double -1.7E+308 1.7E+308 /end CHARACTERISTIC
/begin CHARACTERISTIC model_ColumnSetup_00_cal_impl.signal_offset_InitialCondition "" VALUE 0x0020E718 Scalar_FLOAT64_IEEE 0 model_ColumnSetup_00_CM_double -1.7E+308 1.7E+308 /end CHARACTERISTIC
/begin CHARACTERISTIC model_ColumnSetup_00_cal_impl.sine_amp_Value "" VALUE 0x0020E2C8 Scalar_FLOAT64_IEEE 0 model_ColumnSetup_00_CM_double -1.7E+308 1.7E+308 /end CHARACTERISTIC
/begin CHARACTERISTIC model_ColumnSetup_00_cal_impl.sine_freq_Value "" VALUE 0x0020E2D0 Scalar_FLOAT64_IEEE 0 model_ColumnSetup_00_CM_double -1.7E+308 1.7E+308 /end CHARACTERISTIC
/begin CHARACTERISTIC model_ColumnSetup_00_cal_impl.sine_setpoint_Value "" VALUE 0x0020E2D8 Scalar_FLOAT64_IEEE 0 model_ColumnSetup_00_CM_double -1.7E+308 1.7E+308 /end CHARACTERISTIC
/begin CHARACTERISTIC smooth_stop_enable "Dashboard flag for smooth stop and smooth resume of the command." VALUE 0x00211840 Scalar_FLOAT64_IEEE 0 model_ColumnSetup_00_CM_double -1.7E+308 1.7E+308 /end CHARACTERISTIC
/begin CHARACTERISTIC zero_measurements_enable "Dashboard flag for adaptive measurement zeroing. Direct-access to avoid SLRT page switching hiccups." VALUE 0x00211838 Scalar_FLOAT64_IEEE 0 model_ColumnSetup_00_CM_double -1.7E+308 1.7E+308 /end CHARACTERISTIC
/begin MEASUREMENT model_ColumnSetup_00_B.AnalogControllervsDigitalContro "" FLOAT64_IEEE model_ColumnSetup_00_CM_double 0 0 -1.7E+308 1.7E+308 ECU_ADDRESS 0x00211658 /end MEASUREMENT
/begin MEASUREMENT model_ColumnSetup_00_B.Analoginput "" FLOAT64_IEEE model_ColumnSetup_00_CM_double 0 0 -1.7E+308 1.7E+308 LAYOUT COLUMN_DIR MATRIX_DIM 18 ECU_ADDRESS 0x002116B0 /end MEASUREMENT
/begin MEASUREMENT model_ColumnSetup_00_B.BLWNPauseGate "" FLOAT64_IEEE model_ColumnSetup_00_CM_double 0 0 -1.7E+308 1.7E+308 ECU_ADDRESS 0x00211800 /end MEASUREMENT
/begin MEASUREMENT model_ColumnSetup_00_B.Controllerplaceholder "" FLOAT64_IEEE model_ColumnSetup_00_CM_double 0 0 -1.7E+308 1.7E+308 ECU_ADDRESS 0x00211648 /end MEASUREMENT
/begin MEASUREMENT model_ColumnSetup_00_B.DigitalFilter "" FLOAT64_IEEE model_ColumnSetup_00_CM_double 0 0 -1.7E+308 1.7E+308 ECU_ADDRESS 0x00211630 /end MEASUREMENT
/begin MEASUREMENT model_ColumnSetup_00_B.Gain "" FLOAT64_IEEE model_ColumnSetup_00_CM_double 0 0 -1.7E+308 1.7E+308 ECU_ADDRESS 0x002117D0 /end MEASUREMENT
/begin MEASUREMENT model_ColumnSetup_00_B.Gain1 "" FLOAT64_IEEE model_ColumnSetup_00_CM_double 0 0 -1.7E+308 1.7E+308 ECU_ADDRESS 0x00211798 /end MEASUREMENT
/begin MEASUREMENT model_ColumnSetup_00_B.Gain1_j "" FLOAT64_IEEE model_ColumnSetup_00_CM_double 0 0 -1.7E+308 1.7E+308 ECU_ADDRESS 0x00211808 /end MEASUREMENT
/begin MEASUREMENT model_ColumnSetup_00_B.Gain2 "" FLOAT64_IEEE model_ColumnSetup_00_CM_double 0 0 -1.7E+308 1.7E+308 ECU_ADDRESS 0x00211740 /end MEASUREMENT
/begin MEASUREMENT model_ColumnSetup_00_B.Gain4 "" FLOAT64_IEEE model_ColumnSetup_00_CM_double 0 0 -1.7E+308 1.7E+308 ECU_ADDRESS 0x00211768 /end MEASUREMENT
/begin MEASUREMENT model_ColumnSetup_00_B.Gain_c "" FLOAT64_IEEE model_ColumnSetup_00_CM_double 0 0 -1.7E+308 1.7E+308 ECU_ADDRESS 0x002117F8 /end MEASUREMENT
/begin MEASUREMENT model_ColumnSetup_00_B.Mux_51 "" FLOAT64_IEEE model_ColumnSetup_00_CM_double 0 0 -1.7E+308 1.7E+308 LAYOUT COLUMN_DIR MATRIX_DIM 5 ECU_ADDRESS 0x002117A0 /end MEASUREMENT
/begin MEASUREMENT model_ColumnSetup_00_B.Output "" FLOAT64_IEEE model_ColumnSetup_00_CM_double 0 0 -1.7E+308 1.7E+308 ECU_ADDRESS 0x00211628 /end MEASUREMENT
/begin MEASUREMENT model_ColumnSetup_00_B.Output_p "" FLOAT64_IEEE model_ColumnSetup_00_CM_double 0 0 -1.7E+308 1.7E+308 ECU_ADDRESS 0x002117F0 /end MEASUREMENT
/begin MEASUREMENT model_ColumnSetup_00_B.Populatecommand "" FLOAT64_IEEE model_ColumnSetup_00_CM_double 0 0 -1.7E+308 1.7E+308 LAYOUT COLUMN_DIR MATRIX_DIM 7 ECU_ADDRESS 0x00211678 /end MEASUREMENT
/begin MEASUREMENT model_ColumnSetup_00_B.Product "" FLOAT64_IEEE model_ColumnSetup_00_CM_double 0 0 -1.7E+308 1.7E+308 ECU_ADDRESS 0x002117C8 /end MEASUREMENT
/begin MEASUREMENT model_ColumnSetup_00_B.Product1 "" FLOAT64_IEEE model_ColumnSetup_00_CM_double 0 0 -1.7E+308 1.7E+308 ECU_ADDRESS 0x002117D8 /end MEASUREMENT
/begin MEASUREMENT model_ColumnSetup_00_B.Product2 "" FLOAT64_IEEE model_ColumnSetup_00_CM_double 0 0 -1.7E+308 1.7E+308 ECU_ADDRESS 0x002117E8 /end MEASUREMENT
/begin MEASUREMENT model_ColumnSetup_00_B.SmoothStopClock "" FLOAT64_IEEE model_ColumnSetup_00_CM_double 0 0 -1.7E+308 1.7E+308 ECU_ADDRESS 0x00211640 /end MEASUREMENT
/begin MEASUREMENT model_ColumnSetup_00_B.Subtract1 "" FLOAT64_IEEE model_ColumnSetup_00_CM_double 0 0 -1.7E+308 1.7E+308 ECU_ADDRESS 0x00211668 /end MEASUREMENT
/begin MEASUREMENT model_ColumnSetup_00_B.Sum "" FLOAT64_IEEE model_ColumnSetup_00_CM_double 0 0 -1.7E+308 1.7E+308 ECU_ADDRESS 0x002117E0 /end MEASUREMENT
/begin MEASUREMENT model_ColumnSetup_00_B.TimeHistoryLookup "" FLOAT64_IEEE model_ColumnSetup_00_CM_double 0 0 -1.7E+308 1.7E+308 ECU_ADDRESS 0x00211810 /end MEASUREMENT
/begin MEASUREMENT model_ColumnSetup_00_B.WhiteNoise "" FLOAT64_IEEE model_ColumnSetup_00_CM_double 0 0 -1.7E+308 1.7E+308 ECU_ADDRESS 0x00211620 /end MEASUREMENT
/begin MEASUREMENT model_ColumnSetup_00_B.dcmm "" FLOAT64_IEEE model_ColumnSetup_00_CM_double 0 0 -1.7E+308 1.7E+308 ECU_ADDRESS 0x00211650 /end MEASUREMENT
/begin MEASUREMENT model_ColumnSetup_00_B.dd "" FLOAT64_IEEE model_ColumnSetup_00_CM_double 0 0 -1.7E+308 1.7E+308 ECU_ADDRESS 0x00211638 /end MEASUREMENT
/begin MEASUREMENT model_ColumnSetup_00_B.enableupdate "" FLOAT64_IEEE model_ColumnSetup_00_CM_double 0 0 -1.7E+308 1.7E+308 ECU_ADDRESS 0x00211758 /end MEASUREMENT
/begin MEASUREMENT model_ColumnSetup_00_B.enableupdate_c "" FLOAT64_IEEE model_ColumnSetup_00_CM_double 0 0 -1.7E+308 1.7E+308 ECU_ADDRESS 0x00211788 /end MEASUREMENT
/begin MEASUREMENT model_ColumnSetup_00_B.offsetupdate "" FLOAT64_IEEE model_ColumnSetup_00_CM_double 0 0 -1.7E+308 1.7E+308 ECU_ADDRESS 0x00211760 /end MEASUREMENT
/begin MEASUREMENT model_ColumnSetup_00_B.offsetupdate_i "" FLOAT64_IEEE model_ColumnSetup_00_CM_double 0 0 -1.7E+308 1.7E+308 ECU_ADDRESS 0x00211790 /end MEASUREMENT
/begin MEASUREMENT model_ColumnSetup_00_B.sf_PausableTime.tau "" FLOAT64_IEEE model_ColumnSetup_00_CM_double 0 0 -1.7E+308 1.7E+308 ECU_ADDRESS 0x00211830 /end MEASUREMENT
/begin MEASUREMENT model_ColumnSetup_00_B.sf_PausableTime1.tau "" FLOAT64_IEEE model_ColumnSetup_00_CM_double 0 0 -1.7E+308 1.7E+308 ECU_ADDRESS 0x00211828 /end MEASUREMENT
/begin MEASUREMENT model_ColumnSetup_00_B.signal_offset "" FLOAT64_IEEE model_ColumnSetup_00_CM_double 0 0 -1.7E+308 1.7E+308 ECU_ADDRESS 0x00211660 /end MEASUREMENT
/begin MEASUREMENT model_ColumnSetup_00_B.signal_offset_n "" FLOAT64_IEEE model_ColumnSetup_00_CM_double 0 0 -1.7E+308 1.7E+308 ECU_ADDRESS 0x00211770 /end MEASUREMENT
/begin MEASUREMENT model_ColumnSetup_00_B.signalminusoffset "" FLOAT64_IEEE model_ColumnSetup_00_CM_double 0 0 -1.7E+308 1.7E+308 ECU_ADDRESS 0x00211748 /end MEASUREMENT
/begin MEASUREMENT model_ColumnSetup_00_B.signalminusoffset_l "" FLOAT64_IEEE model_ColumnSetup_00_CM_double 0 0 -1.7E+308 1.7E+308 ECU_ADDRESS 0x00211778 /end MEASUREMENT
/begin MEASUREMENT model_ColumnSetup_00_B.u "" FLOAT64_IEEE model_ColumnSetup_00_CM_double 0 0 -1.7E+308 1.7E+308 ECU_ADDRESS 0x00211670 /end MEASUREMENT
/begin MEASUREMENT model_ColumnSetup_00_B.y "" FLOAT64_IEEE model_ColumnSetup_00_CM_double 0 0 -1.7E+308 1.7E+308 ECU_ADDRESS 0x00211818 /end MEASUREMENT
/begin MEASUREMENT model_ColumnSetup_00_B.y_f "" FLOAT64_IEEE model_ColumnSetup_00_CM_double 0 0 -1.7E+308 1.7E+308 ECU_ADDRESS 0x00211820 /end MEASUREMENT
/begin MEASUREMENT model_ColumnSetup_00_B.zero_alpha "" FLOAT64_IEEE model_ColumnSetup_00_CM_double 0 0 -1.7E+308 1.7E+308 ECU_ADDRESS 0x00211750 /end MEASUREMENT
/begin MEASUREMENT model_ColumnSetup_00_B.zero_alpha_m "" FLOAT64_IEEE model_ColumnSetup_00_CM_double 0 0 -1.7E+308 1.7E+308 ECU_ADDRESS 0x00211780 /end MEASUREMENT
/begin MEASUREMENT model_ColumnSetup_00_DW.DigitalFilter_states "" FLOAT64_IEEE model_ColumnSetup_00_CM_double 0 0 -1.7E+308 1.7E+308 LAYOUT COLUMN_DIR MATRIX_DIM 130 ECU_ADDRESS 0x002110E0 /end MEASUREMENT
/begin MEASUREMENT model_ColumnSetup_00_DW.NextOutput "" FLOAT64_IEEE model_ColumnSetup_00_CM_double 0 0 -1.7E+308 1.7E+308 ECU_ADDRESS 0x00211500 /end MEASUREMENT
/begin MEASUREMENT model_ColumnSetup_00_DW.RandSeed "" ULONG model_ColumnSetup_00_CM_uint32 0 0 0 2147483646 ECU_ADDRESS 0x002115F0 /end MEASUREMENT
/begin MEASUREMENT model_ColumnSetup_00_DW.amp_prev "" FLOAT64_IEEE model_ColumnSetup_00_CM_double 0 0 -1.7E+308 1.7E+308 ECU_ADDRESS 0x00211538 /end MEASUREMENT
/begin MEASUREMENT model_ColumnSetup_00_DW.blend "" FLOAT64_IEEE model_ColumnSetup_00_CM_double 0 0 -1.7E+308 1.7E+308 ECU_ADDRESS 0x00211518 /end MEASUREMENT
/begin MEASUREMENT model_ColumnSetup_00_DW.blend0 "" FLOAT64_IEEE model_ColumnSetup_00_CM_double 0 0 -1.7E+308 1.7E+308 ECU_ADDRESS 0x00211510 /end MEASUREMENT
/begin MEASUREMENT model_ColumnSetup_00_DW.last_enable "" UBYTE model_ColumnSetup_00_CM_logical 0 0 0 1 ECU_ADDRESS 0x00211600 /end MEASUREMENT
/begin MEASUREMENT model_ColumnSetup_00_DW.offset "" FLOAT64_IEEE model_ColumnSetup_00_CM_double 0 0 -1.7E+308 1.7E+308 ECU_ADDRESS 0x00211528 /end MEASUREMENT
/begin MEASUREMENT model_ColumnSetup_00_DW.phase "" FLOAT64_IEEE model_ColumnSetup_00_CM_double 0 0 -1.7E+308 1.7E+308 ECU_ADDRESS 0x00211520 /end MEASUREMENT
/begin MEASUREMENT model_ColumnSetup_00_DW.phase_not_empty "" UBYTE model_ColumnSetup_00_CM_logical 0 0 0 1 ECU_ADDRESS 0x00211601 /end MEASUREMENT
/begin MEASUREMENT model_ColumnSetup_00_DW.setpoint_prev "" FLOAT64_IEEE model_ColumnSetup_00_CM_double 0 0 -1.7E+308 1.7E+308 ECU_ADDRESS 0x00211540 /end MEASUREMENT
/begin MEASUREMENT model_ColumnSetup_00_DW.sf_PausableTime.tau_state "" FLOAT64_IEEE model_ColumnSetup_00_CM_double 0 0 -1.7E+308 1.7E+308 ECU_ADDRESS 0x00211610 /end MEASUREMENT
/begin MEASUREMENT model_ColumnSetup_00_DW.sf_PausableTime1.tau_state "" FLOAT64_IEEE model_ColumnSetup_00_CM_double 0 0 -1.7E+308 1.7E+308 ECU_ADDRESS 0x00211608 /end MEASUREMENT
/begin MEASUREMENT model_ColumnSetup_00_DW.signal_offset_DSTATE "" FLOAT64_IEEE model_ColumnSetup_00_CM_double 0 0 -1.7E+308 1.7E+308 ECU_ADDRESS 0x002114F0 /end MEASUREMENT
/begin MEASUREMENT model_ColumnSetup_00_DW.signal_offset_DSTATE_l "" FLOAT64_IEEE model_ColumnSetup_00_CM_double 0 0 -1.7E+308 1.7E+308 ECU_ADDRESS 0x002114F8 /end MEASUREMENT
/begin MEASUREMENT model_ColumnSetup_00_DW.startup_active "" UBYTE model_ColumnSetup_00_CM_logical 0 0 0 1 ECU_ADDRESS 0x00211602 /end MEASUREMENT
/begin MEASUREMENT model_ColumnSetup_00_DW.startup_done "" UBYTE model_ColumnSetup_00_CM_logical 0 0 0 1 ECU_ADDRESS 0x00211603 /end MEASUREMENT
/begin MEASUREMENT model_ColumnSetup_00_DW.startup_t "" FLOAT64_IEEE model_ColumnSetup_00_CM_double 0 0 -1.7E+308 1.7E+308 ECU_ADDRESS 0x00211548 /end MEASUREMENT
/begin MEASUREMENT model_ColumnSetup_00_DW.startup_y0 "" FLOAT64_IEEE model_ColumnSetup_00_CM_double 0 0 -1.7E+308 1.7E+308 ECU_ADDRESS 0x00211550 /end MEASUREMENT
/begin MEASUREMENT model_ColumnSetup_00_DW.t0 "" FLOAT64_IEEE model_ColumnSetup_00_CM_double 0 0 -1.7E+308 1.7E+308 ECU_ADDRESS 0x00211508 /end MEASUREMENT
/begin MEASUREMENT model_ColumnSetup_00_DW.y_prev "" FLOAT64_IEEE model_ColumnSetup_00_CM_double 0 0 -1.7E+308 1.7E+308 ECU_ADDRESS 0x00211530 /end MEASUREMENT
/begin AXIS_PTS model_ColumnSetup_00_cal_impl.TimeHistoryLookup_bp01Data "" 0x0020E040 model_ColumnSetup_00_B.sf_PausableTime.tau Axis_FLOAT64_IEEE 0 model_ColumnSetup_00_CM_double 2 -1.7E+308 1.7E+308 /end AXIS_PTS
/begin COMPU_METHOD model_ColumnSetup_00_CM_double "" IDENTICAL "%15.10" "" /end COMPU_METHOD
/begin COMPU_METHOD model_ColumnSetup_00_CM_logical "" IDENTICAL "%1.0" "" /end COMPU_METHOD
/begin COMPU_METHOD model_ColumnSetup_00_CM_uint32 "" IDENTICAL "%10.0" "" /end COMPU_METHOD
/begin RECORD_LAYOUT Lookup1D_FLOAT64_IEEE FNC_VALUES 1 FLOAT64_IEEE COLUMN_DIR DIRECT /end RECORD_LAYOUT
/begin RECORD_LAYOUT Scalar_BOOLEAN FNC_VALUES 1 UBYTE COLUMN_DIR DIRECT /end RECORD_LAYOUT
/begin RECORD_LAYOUT Scalar_FLOAT64_IEEE FNC_VALUES 1 FLOAT64_IEEE COLUMN_DIR DIRECT /end RECORD_LAYOUT
/begin RECORD_LAYOUT Scalar_ULONG FNC_VALUES 1 ULONG COLUMN_DIR DIRECT /end RECORD_LAYOUT
/begin RECORD_LAYOUT Axis_FLOAT64_IEEE AXIS_PTS_X 1 FLOAT64_IEEE INDEX_INCR DIRECT /end RECORD_LAYOUT
/begin GROUP model_ColumnSetup_00 "model_ColumnSetup_00" ROOT
 /begin REF_CHARACTERISTIC dd_pause_enable smooth_stop_enable zero_measurements_enable /end REF_CHARACTERISTIC
/end GROUP
/end MODULE
/end PROJECT
