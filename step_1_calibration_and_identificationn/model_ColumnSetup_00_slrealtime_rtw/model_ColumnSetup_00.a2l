/******************************************************************************
* ASAP2 file: model_ColumnSetup_00.a2l
* Academic License - for use in teaching, academic research, and meeting
* course requirements at degree granting institutions only. Not for
* government, commercial, or other organizational use.
* Code generation for model "model_ColumnSetup_00".
* Model version : 16.127
* Simulink Coder version : 10.2 R2020b
* C source code generated on : Sun May 31 20:52:40 2026
* Target selection: slrealtime.tlc
* Embedded hardware selection: Intel->x86-64 (Linux 64)
* Code generation objectives: Unspecified
* Validation result: Not run
* (add additional file header information here)
******************************************************************************/ ASAP2_VERSION 1 71
/begin PROJECT ProjectName "Project Comment Goes Here"
/begin HEADER "Header Comments go here" /end HEADER
/begin MODULE ModuleName "Module Comment Goes Here"
/begin IF_DATA XCP
 /begin PROTOCOL_LAYER 0x0100 0x03E8 0x00C8 0x0000 0x0000 0x0000 0x0000 0x0000 0xFC 0x0578 BYTE_ORDER_MSB_LAST ADDRESS_GRANULARITY_BYTE OPTIONAL_CMD ALLOC_ODT_ENTRY OPTIONAL_CMD ALLOC_ODT OPTIONAL_CMD ALLOC_DAQ OPTIONAL_CMD FREE_DAQ OPTIONAL_CMD GET_DAQ_RESOLUTION_INFO OPTIONAL_CMD GET_DAQ_PROCESSOR_INFO OPTIONAL_CMD START_STOP_SYNCH OPTIONAL_CMD START_STOP_DAQ_LIST OPTIONAL_CMD SET_DAQ_LIST_MODE OPTIONAL_CMD WRITE_DAQ OPTIONAL_CMD SET_DAQ_PTR OPTIONAL_CMD GET_CAL_PAGE OPTIONAL_CMD SET_CAL_PAGE OPTIONAL_CMD COPY_CAL_PAGE OPTIONAL_CMD SHORT_DOWNLOAD OPTIONAL_CMD DOWNLOAD_MAX OPTIONAL_CMD DOWNLOAD OPTIONAL_CMD SHORT_UPLOAD OPTIONAL_CMD UPLOAD OPTIONAL_CMD SET_MTA /end PROTOCOL_LAYER
 /begin DAQ DYNAMIC 0x0000 0x0080 0x00 OPTIMISATION_TYPE_DEFAULT ADDRESS_EXTENSION_FREE IDENTIFICATION_FIELD_TYPE_RELATIVE_WORD_ALIGNED GRANULARITY_ODT_ENTRY_SIZE_DAQ_BYTE 0xFF OVERLOAD_INDICATION_PID PRESCALER_SUPPORTED /begin STIM GRANULARITY_ODT_ENTRY_SIZE_STIM_BYTE 0xFF /end STIM /begin TIMESTAMP_SUPPORTED 0x0001 SIZE_DWORD UNIT_1US TIMESTAMP_FIXED /end TIMESTAMP_SUPPORTED /begin EVENT "490 us" "490 us" 0x0000 DAQ 0xFF 0x31 0x04 0x00 /end EVENT /end DAQ
 /begin XCP_ON_UDP_IP 0x0100 0x15B3 ADDRESS "192.168.7.5" /end XCP_ON_UDP_IP
/end IF_DATA
/begin MOD_PAR "MOD PAR Comment Goes Here"
 /begin MEMORY_SEGMENT model_ColumnSetup_00_cal_impl "model_ColumnSetup_00_cal_impl" DATA FLASH INTERN 0x00466020 0x910 -1 -1 -1 -1 -1
  /begin IF_DATA XCP
   /begin SEGMENT 0x00 0x02 0x00 0x00 0x00
    /begin PAGE 0x00 ECU_ACCESS_DONT_CARE XCP_READ_ACCESS_DONT_CARE XCP_WRITE_ACCESS_NOT_ALLOWED /end PAGE
    /begin PAGE 0x01 ECU_ACCESS_DONT_CARE XCP_READ_ACCESS_DONT_CARE XCP_WRITE_ACCESS_DONT_CARE /end PAGE
   /end SEGMENT
  /end IF_DATA
 /end MEMORY_SEGMENT
/end MOD_PAR
/begin MOD_COMMON "Mod Common Comment Here" BYTE_ORDER MSB_LAST /end MOD_COMMON
/begin CHARACTERISTIC model_ColumnSetup_00_P.ch.am "" VALUE 0x00466940 Scalar_FLOAT64_IEEE 0 model_ColumnSetup_00_CM_double -1.7E+308 1.7E+308 /end CHARACTERISTIC
/begin CHARACTERISTIC model_ColumnSetup_00_P.ch.dd "" VALUE 0x00466958 Scalar_FLOAT64_IEEE 0 model_ColumnSetup_00_CM_double -1.7E+308 1.7E+308 /end CHARACTERISTIC
/begin CHARACTERISTIC model_ColumnSetup_00_P.ch.dm "" VALUE 0x00466948 Scalar_FLOAT64_IEEE 0 model_ColumnSetup_00_CM_double -1.7E+308 1.7E+308 /end CHARACTERISTIC
/begin CHARACTERISTIC model_ColumnSetup_00_P.ch.fm "" VALUE 0x00466950 Scalar_FLOAT64_IEEE 0 model_ColumnSetup_00_CM_double -1.7E+308 1.7E+308 /end CHARACTERISTIC
/begin CHARACTERISTIC model_ColumnSetup_00_P.chirp_gain "" VALUE 0x00466960 Scalar_FLOAT64_IEEE 0 model_ColumnSetup_00_CM_double -1.7E+308 1.7E+308 /end CHARACTERISTIC
/begin CHARACTERISTIC model_ColumnSetup_00_P.command_channel_selector "" VAL_BLK 0x00466968 Scalar_FLOAT64_IEEE 0 model_ColumnSetup_00_CM_double -1.7E+308 1.7E+308 MATRIX_DIM 1 7 /end CHARACTERISTIC
/begin CHARACTERISTIC model_ColumnSetup_00_P.correction_gain "" VALUE 0x004669A0 Scalar_FLOAT64_IEEE 0 model_ColumnSetup_00_CM_double -1.7E+308 1.7E+308 /end CHARACTERISTIC
/begin CHARACTERISTIC model_ColumnSetup_00_P.f_final "" VALUE 0x004669A8 Scalar_FLOAT64_IEEE 0 model_ColumnSetup_00_CM_double -1.7E+308 1.7E+308 /end CHARACTERISTIC
/begin CHARACTERISTIC model_ColumnSetup_00_P.f_init "" VALUE 0x004669B0 Scalar_FLOAT64_IEEE 0 model_ColumnSetup_00_CM_double -1.7E+308 1.7E+308 /end CHARACTERISTIC
/begin CHARACTERISTIC model_ColumnSetup_00_P.ini_v "" VAL_BLK 0x004669B8 Scalar_FLOAT64_IEEE 0 model_ColumnSetup_00_CM_double -1.7E+308 1.7E+308 MATRIX_DIM 18 1 /end CHARACTERISTIC
/begin CHARACTERISTIC model_ColumnSetup_00_P.sat_limit "" VALUE 0x00466A48 Scalar_FLOAT64_IEEE 0 model_ColumnSetup_00_CM_double -1.7E+308 1.7E+308 /end CHARACTERISTIC
/begin CHARACTERISTIC model_ColumnSetup_00_P.tend_chirp "" VALUE 0x00466A50 Scalar_FLOAT64_IEEE 0 model_ColumnSetup_00_CM_double -1.7E+308 1.7E+308 /end CHARACTERISTIC
/begin CHARACTERISTIC model_ColumnSetup_00_P.test_signal "" VALUE 0x00466A58 Scalar_FLOAT64_IEEE 0 model_ColumnSetup_00_CM_double -1.7E+308 1.7E+308 /end CHARACTERISTIC
/begin CHARACTERISTIC model_ColumnSetup_00_P.v2a_const "" VALUE 0x00466A60 Scalar_FLOAT64_IEEE 0 model_ColumnSetup_00_CM_double -1.7E+308 1.7E+308 /end CHARACTERISTIC
/begin CHARACTERISTIC model_ColumnSetup_00_P.v2a_gain "" VALUE 0x00466A68 Scalar_FLOAT64_IEEE 0 model_ColumnSetup_00_CM_double -1.7E+308 1.7E+308 /end CHARACTERISTIC
/begin CHARACTERISTIC model_ColumnSetup_00_P.v2d_const "" VALUE 0x00466A70 Scalar_FLOAT64_IEEE 0 model_ColumnSetup_00_CM_double -1.7E+308 1.7E+308 /end CHARACTERISTIC
/begin CHARACTERISTIC model_ColumnSetup_00_P.v2d_gain "" VALUE 0x00466A78 Scalar_FLOAT64_IEEE 0 model_ColumnSetup_00_CM_double -1.7E+308 1.7E+308 /end CHARACTERISTIC
/begin CHARACTERISTIC model_ColumnSetup_00_P.v2f_const "" VALUE 0x00466A80 Scalar_FLOAT64_IEEE 0 model_ColumnSetup_00_CM_double -1.7E+308 1.7E+308 /end CHARACTERISTIC
/begin CHARACTERISTIC model_ColumnSetup_00_P.v2f_gain "" VALUE 0x00466A88 Scalar_FLOAT64_IEEE 0 model_ColumnSetup_00_CM_double -1.7E+308 1.7E+308 /end CHARACTERISTIC
/begin CHARACTERISTIC model_ColumnSetup_00_P.wn_power "" VALUE 0x00466A90 Scalar_FLOAT64_IEEE 0 model_ColumnSetup_00_CM_double -1.7E+308 1.7E+308 /end CHARACTERISTIC
/begin CHARACTERISTIC model_ColumnSetup_00_cal_impl.AnalogOutput_P1 "" VALUE 0x004666E8 Scalar_FLOAT64_IEEE 0 model_ColumnSetup_00_CM_double -1.7E+308 1.7E+308 /end CHARACTERISTIC
/begin CHARACTERISTIC model_ColumnSetup_00_cal_impl.AnalogOutput_P2 "" VAL_BLK 0x00466700 Scalar_FLOAT64_IEEE 0 model_ColumnSetup_00_CM_double -1.7E+308 1.7E+308 MATRIX_DIM 7 1 /end CHARACTERISTIC
/begin CHARACTERISTIC model_ColumnSetup_00_cal_impl.AnalogOutput_P3 "" VAL_BLK 0x00466748 Scalar_FLOAT64_IEEE 0 model_ColumnSetup_00_CM_double -1.7E+308 1.7E+308 MATRIX_DIM 7 1 /end CHARACTERISTIC
/begin CHARACTERISTIC model_ColumnSetup_00_cal_impl.AnalogOutput_P4 "" VALUE 0x00466790 Scalar_FLOAT64_IEEE 0 model_ColumnSetup_00_CM_double -1.7E+308 1.7E+308 /end CHARACTERISTIC
/begin CHARACTERISTIC model_ColumnSetup_00_cal_impl.AnalogOutput_P5 "" VALUE 0x004667A8 Scalar_FLOAT64_IEEE 0 model_ColumnSetup_00_CM_double -1.7E+308 1.7E+308 /end CHARACTERISTIC
/begin CHARACTERISTIC model_ColumnSetup_00_cal_impl.AnalogOutput_P6 "" VALUE 0x004667C0 Scalar_FLOAT64_IEEE 0 model_ColumnSetup_00_CM_double -1.7E+308 1.7E+308 /end CHARACTERISTIC
/begin CHARACTERISTIC model_ColumnSetup_00_cal_impl.Analoginput_P1 "" VALUE 0x004668B0 Scalar_FLOAT64_IEEE 0 model_ColumnSetup_00_CM_double -1.7E+308 1.7E+308 /end CHARACTERISTIC
/begin CHARACTERISTIC model_ColumnSetup_00_cal_impl.Analoginput_P2 "" VALUE 0x004668C8 Scalar_FLOAT64_IEEE 0 model_ColumnSetup_00_CM_double -1.7E+308 1.7E+308 /end CHARACTERISTIC
/begin CHARACTERISTIC model_ColumnSetup_00_cal_impl.Analoginput_P3 "" VALUE 0x004668E0 Scalar_FLOAT64_IEEE 0 model_ColumnSetup_00_CM_double -1.7E+308 1.7E+308 /end CHARACTERISTIC
/begin CHARACTERISTIC model_ColumnSetup_00_cal_impl.Analoginput_P4 "" VALUE 0x004668F8 Scalar_FLOAT64_IEEE 0 model_ColumnSetup_00_CM_double -1.7E+308 1.7E+308 /end CHARACTERISTIC
/begin CHARACTERISTIC model_ColumnSetup_00_cal_impl.Analoginput_P5 "" VALUE 0x00466910 Scalar_FLOAT64_IEEE 0 model_ColumnSetup_00_CM_double -1.7E+308 1.7E+308 /end CHARACTERISTIC
/begin CHARACTERISTIC model_ColumnSetup_00_cal_impl.Analoginput_P6 "" VALUE 0x00466928 Scalar_FLOAT64_IEEE 0 model_ColumnSetup_00_CM_double -1.7E+308 1.7E+308 /end CHARACTERISTIC
/begin CHARACTERISTIC model_ColumnSetup_00_cal_impl.BandLimitedWhiteNoise_seed "" VALUE 0x00466020 Scalar_FLOAT64_IEEE 0 model_ColumnSetup_00_CM_double -1.7E+308 1.7E+308 /end CHARACTERISTIC
/begin CHARACTERISTIC model_ColumnSetup_00_cal_impl.Constant1_Value "" VALUE 0x004666C8 Scalar_FLOAT64_IEEE 0 model_ColumnSetup_00_CM_double -1.7E+308 1.7E+308 /end CHARACTERISTIC
/begin CHARACTERISTIC model_ColumnSetup_00_cal_impl.Controllerplaceholder_Gain "" VALUE 0x004666D0 Scalar_FLOAT64_IEEE 0 model_ColumnSetup_00_CM_double -1.7E+308 1.7E+308 /end CHARACTERISTIC
/begin CHARACTERISTIC model_ColumnSetup_00_cal_impl.DigitalFilter_Coefficients "" VAL_BLK 0x004662A0 Scalar_FLOAT64_IEEE 0 model_ColumnSetup_00_CM_double -1.7E+308 1.7E+308 MATRIX_DIM 131 1 /end CHARACTERISTIC
/begin CHARACTERISTIC model_ColumnSetup_00_cal_impl.DigitalFilter_InitialStates "" VALUE 0x00466298 Scalar_FLOAT64_IEEE 0 model_ColumnSetup_00_CM_double -1.7E+308 1.7E+308 /end CHARACTERISTIC
/begin CHARACTERISTIC model_ColumnSetup_00_cal_impl.Gain1_Gain "" VALUE 0x004666B8 Scalar_FLOAT64_IEEE 0 model_ColumnSetup_00_CM_double -1.7E+308 1.7E+308 /end CHARACTERISTIC
/begin CHARACTERISTIC model_ColumnSetup_00_cal_impl.Gain_Gain "" VALUE 0x004666C0 Scalar_FLOAT64_IEEE 0 model_ColumnSetup_00_CM_double -1.7E+308 1.7E+308 /end CHARACTERISTIC
/begin CHARACTERISTIC model_ColumnSetup_00_cal_impl.Setup_P1 "" VALUE 0x00466038 Scalar_FLOAT64_IEEE 0 model_ColumnSetup_00_CM_double -1.7E+308 1.7E+308 /end CHARACTERISTIC
/begin CHARACTERISTIC model_ColumnSetup_00_cal_impl.Setup_P10 "" VAL_BLK 0x004661A0 Scalar_FLOAT64_IEEE 0 model_ColumnSetup_00_CM_double -1.7E+308 1.7E+308 MATRIX_DIM 7 1 /end CHARACTERISTIC
/begin CHARACTERISTIC model_ColumnSetup_00_cal_impl.Setup_P11 "" VAL_BLK 0x004661E8 Scalar_FLOAT64_IEEE 0 model_ColumnSetup_00_CM_double -1.7E+308 1.7E+308 MATRIX_DIM 4 1 /end CHARACTERISTIC
/begin CHARACTERISTIC model_ColumnSetup_00_cal_impl.Setup_P12 "" VALUE 0x00466218 Scalar_FLOAT64_IEEE 0 model_ColumnSetup_00_CM_double -1.7E+308 1.7E+308 /end CHARACTERISTIC
/begin CHARACTERISTIC model_ColumnSetup_00_cal_impl.Setup_P13 "" VALUE 0x00466230 Scalar_FLOAT64_IEEE 0 model_ColumnSetup_00_CM_double -1.7E+308 1.7E+308 /end CHARACTERISTIC
/begin CHARACTERISTIC model_ColumnSetup_00_cal_impl.Setup_P14 "" VALUE 0x00466248 Scalar_FLOAT64_IEEE 0 model_ColumnSetup_00_CM_double -1.7E+308 1.7E+308 /end CHARACTERISTIC
/begin CHARACTERISTIC model_ColumnSetup_00_cal_impl.Setup_P15 "" VALUE 0x00466260 Scalar_FLOAT64_IEEE 0 model_ColumnSetup_00_CM_double -1.7E+308 1.7E+308 /end CHARACTERISTIC
/begin CHARACTERISTIC model_ColumnSetup_00_cal_impl.Setup_P1_p "" VALUE 0x004667D8 Scalar_FLOAT64_IEEE 0 model_ColumnSetup_00_CM_double -1.7E+308 1.7E+308 /end CHARACTERISTIC
/begin CHARACTERISTIC model_ColumnSetup_00_cal_impl.Setup_P2 "" VALUE 0x00466050 Scalar_FLOAT64_IEEE 0 model_ColumnSetup_00_CM_double -1.7E+308 1.7E+308 /end CHARACTERISTIC
/begin CHARACTERISTIC model_ColumnSetup_00_cal_impl.Setup_P2_j "" VALUE 0x004667F0 Scalar_FLOAT64_IEEE 0 model_ColumnSetup_00_CM_double -1.7E+308 1.7E+308 /end CHARACTERISTIC
/begin CHARACTERISTIC model_ColumnSetup_00_cal_impl.Setup_P3 "" VALUE 0x00466068 Scalar_FLOAT64_IEEE 0 model_ColumnSetup_00_CM_double -1.7E+308 1.7E+308 /end CHARACTERISTIC
/begin CHARACTERISTIC model_ColumnSetup_00_cal_impl.Setup_P3_h "" VALUE 0x00466808 Scalar_FLOAT64_IEEE 0 model_ColumnSetup_00_CM_double -1.7E+308 1.7E+308 /end CHARACTERISTIC
/begin CHARACTERISTIC model_ColumnSetup_00_cal_impl.Setup_P4 "" VALUE 0x00466080 Scalar_FLOAT64_IEEE 0 model_ColumnSetup_00_CM_double -1.7E+308 1.7E+308 /end CHARACTERISTIC
/begin CHARACTERISTIC model_ColumnSetup_00_cal_impl.Setup_P4_m "" VALUE 0x00466820 Scalar_FLOAT64_IEEE 0 model_ColumnSetup_00_CM_double -1.7E+308 1.7E+308 /end CHARACTERISTIC
/begin CHARACTERISTIC model_ColumnSetup_00_cal_impl.Setup_P5 "" VAL_BLK 0x00466098 Scalar_FLOAT64_IEEE 0 model_ColumnSetup_00_CM_double -1.7E+308 1.7E+308 MATRIX_DIM 7 1 /end CHARACTERISTIC
/begin CHARACTERISTIC model_ColumnSetup_00_cal_impl.Setup_P5_o "" VALUE 0x00466838 Scalar_FLOAT64_IEEE 0 model_ColumnSetup_00_CM_double -1.7E+308 1.7E+308 /end CHARACTERISTIC
/begin CHARACTERISTIC model_ColumnSetup_00_cal_impl.Setup_P6 "" VALUE 0x004660E0 Scalar_FLOAT64_IEEE 0 model_ColumnSetup_00_CM_double -1.7E+308 1.7E+308 /end CHARACTERISTIC
/begin CHARACTERISTIC model_ColumnSetup_00_cal_impl.Setup_P6_l "" VALUE 0x00466850 Scalar_FLOAT64_IEEE 0 model_ColumnSetup_00_CM_double -1.7E+308 1.7E+308 /end CHARACTERISTIC
/begin CHARACTERISTIC model_ColumnSetup_00_cal_impl.Setup_P7 "" VALUE 0x004660F8 Scalar_FLOAT64_IEEE 0 model_ColumnSetup_00_CM_double -1.7E+308 1.7E+308 /end CHARACTERISTIC
/begin CHARACTERISTIC model_ColumnSetup_00_cal_impl.Setup_P7_h "" VALUE 0x00466868 Scalar_FLOAT64_IEEE 0 model_ColumnSetup_00_CM_double -1.7E+308 1.7E+308 /end CHARACTERISTIC
/begin CHARACTERISTIC model_ColumnSetup_00_cal_impl.Setup_P8 "" VAL_BLK 0x00466110 Scalar_FLOAT64_IEEE 0 model_ColumnSetup_00_CM_double -1.7E+308 1.7E+308 MATRIX_DIM 7 1 /end CHARACTERISTIC
/begin CHARACTERISTIC model_ColumnSetup_00_cal_impl.Setup_P8_l "" VALUE 0x00466880 Scalar_FLOAT64_IEEE 0 model_ColumnSetup_00_CM_double -1.7E+308 1.7E+308 /end CHARACTERISTIC
/begin CHARACTERISTIC model_ColumnSetup_00_cal_impl.Setup_P9 "" VAL_BLK 0x00466158 Scalar_FLOAT64_IEEE 0 model_ColumnSetup_00_CM_double -1.7E+308 1.7E+308 MATRIX_DIM 7 1 /end CHARACTERISTIC
/begin CHARACTERISTIC model_ColumnSetup_00_cal_impl.Setup_P9_d "" VALUE 0x00466898 Scalar_FLOAT64_IEEE 0 model_ColumnSetup_00_CM_double -1.7E+308 1.7E+308 /end CHARACTERISTIC
/begin CHARACTERISTIC model_ColumnSetup_00_cal_impl.SineWave_Amp "" VALUE 0x00466268 Scalar_FLOAT64_IEEE 0 model_ColumnSetup_00_CM_double -1.7E+308 1.7E+308 /end CHARACTERISTIC
/begin CHARACTERISTIC model_ColumnSetup_00_cal_impl.SineWave_Bias "" VALUE 0x00466270 Scalar_FLOAT64_IEEE 0 model_ColumnSetup_00_CM_double -1.7E+308 1.7E+308 /end CHARACTERISTIC
/begin CHARACTERISTIC model_ColumnSetup_00_cal_impl.SineWave_Freq "" VALUE 0x00466278 Scalar_FLOAT64_IEEE 0 model_ColumnSetup_00_CM_double -1.7E+308 1.7E+308 /end CHARACTERISTIC
/begin CHARACTERISTIC model_ColumnSetup_00_cal_impl.SineWave_Phase "" VALUE 0x00466280 Scalar_FLOAT64_IEEE 0 model_ColumnSetup_00_CM_double -1.7E+308 1.7E+308 /end CHARACTERISTIC
/begin CHARACTERISTIC model_ColumnSetup_00_cal_impl.WhiteNoise_Mean "" VALUE 0x00466288 Scalar_FLOAT64_IEEE 0 model_ColumnSetup_00_CM_double -1.7E+308 1.7E+308 /end CHARACTERISTIC
/begin CHARACTERISTIC model_ColumnSetup_00_cal_impl.WhiteNoise_StdDev "" VALUE 0x00466290 Scalar_FLOAT64_IEEE 0 model_ColumnSetup_00_CM_double -1.7E+308 1.7E+308 /end CHARACTERISTIC
/begin MEASUREMENT model_ColumnSetup_00_B.AnalogControllervsDigitalContro "" FLOAT64_IEEE model_ColumnSetup_00_CM_double 0 0 -1.7E+308 1.7E+308 ECU_ADDRESS 0x00469678 /end MEASUREMENT
/begin MEASUREMENT model_ColumnSetup_00_B.Analoginput "" FLOAT64_IEEE model_ColumnSetup_00_CM_double 0 0 -1.7E+308 1.7E+308 LAYOUT COLUMN_DIR MATRIX_DIM 18 ECU_ADDRESS 0x004696D0 /end MEASUREMENT
/begin MEASUREMENT model_ColumnSetup_00_B.Clock1 "" FLOAT64_IEEE model_ColumnSetup_00_CM_double 0 0 -1.7E+308 1.7E+308 ECU_ADDRESS 0x00469650 /end MEASUREMENT
/begin MEASUREMENT model_ColumnSetup_00_B.DigitalFilter "" FLOAT64_IEEE model_ColumnSetup_00_CM_double 0 0 -1.7E+308 1.7E+308 ECU_ADDRESS 0x00469640 /end MEASUREMENT
/begin MEASUREMENT model_ColumnSetup_00_B.Gain "" FLOAT64_IEEE model_ColumnSetup_00_CM_double 0 0 -1.7E+308 1.7E+308 ECU_ADDRESS 0x00469660 /end MEASUREMENT
/begin MEASUREMENT model_ColumnSetup_00_B.Gain1 "" FLOAT64_IEEE model_ColumnSetup_00_CM_double 0 0 -1.7E+308 1.7E+308 ECU_ADDRESS 0x00469648 /end MEASUREMENT
/begin MEASUREMENT model_ColumnSetup_00_B.Gain1_g "" FLOAT64_IEEE model_ColumnSetup_00_CM_double 0 0 -1.7E+308 1.7E+308 ECU_ADDRESS 0x00469798 /end MEASUREMENT
/begin MEASUREMENT model_ColumnSetup_00_B.Gain2 "" FLOAT64_IEEE model_ColumnSetup_00_CM_double 0 0 -1.7E+308 1.7E+308 ECU_ADDRESS 0x00469778 /end MEASUREMENT
/begin MEASUREMENT model_ColumnSetup_00_B.Gain4 "" FLOAT64_IEEE model_ColumnSetup_00_CM_double 0 0 -1.7E+308 1.7E+308 ECU_ADDRESS 0x00469788 /end MEASUREMENT
/begin MEASUREMENT model_ColumnSetup_00_B.Gain_c "" FLOAT64_IEEE model_ColumnSetup_00_CM_double 0 0 -1.7E+308 1.7E+308 ECU_ADDRESS 0x004697C8 /end MEASUREMENT
/begin MEASUREMENT model_ColumnSetup_00_B.Mux_51 "" FLOAT64_IEEE model_ColumnSetup_00_CM_double 0 0 -1.7E+308 1.7E+308 LAYOUT COLUMN_DIR MATRIX_DIM 6 ECU_ADDRESS 0x004697D0 /end MEASUREMENT
/begin MEASUREMENT model_ColumnSetup_00_B.Output "" FLOAT64_IEEE model_ColumnSetup_00_CM_double 0 0 -1.7E+308 1.7E+308 ECU_ADDRESS 0x00469638 /end MEASUREMENT
/begin MEASUREMENT model_ColumnSetup_00_B.Output_p "" FLOAT64_IEEE model_ColumnSetup_00_CM_double 0 0 -1.7E+308 1.7E+308 ECU_ADDRESS 0x004697C0 /end MEASUREMENT
/begin MEASUREMENT model_ColumnSetup_00_B.Populatecommand "" FLOAT64_IEEE model_ColumnSetup_00_CM_double 0 0 -1.7E+308 1.7E+308 LAYOUT COLUMN_DIR MATRIX_DIM 7 ECU_ADDRESS 0x00469698 /end MEASUREMENT
/begin MEASUREMENT model_ColumnSetup_00_B.Product "" FLOAT64_IEEE model_ColumnSetup_00_CM_double 0 0 -1.7E+308 1.7E+308 ECU_ADDRESS 0x00469658 /end MEASUREMENT
/begin MEASUREMENT model_ColumnSetup_00_B.Product1 "" FLOAT64_IEEE model_ColumnSetup_00_CM_double 0 0 -1.7E+308 1.7E+308 ECU_ADDRESS 0x004697A8 /end MEASUREMENT
/begin MEASUREMENT model_ColumnSetup_00_B.Product2 "" FLOAT64_IEEE model_ColumnSetup_00_CM_double 0 0 -1.7E+308 1.7E+308 ECU_ADDRESS 0x004697B8 /end MEASUREMENT
/begin MEASUREMENT model_ColumnSetup_00_B.SineWave "" FLOAT64_IEEE model_ColumnSetup_00_CM_double 0 0 -1.7E+308 1.7E+308 ECU_ADDRESS 0x00469628 /end MEASUREMENT
/begin MEASUREMENT model_ColumnSetup_00_B.Subtract1 "" FLOAT64_IEEE model_ColumnSetup_00_CM_double 0 0 -1.7E+308 1.7E+308 ECU_ADDRESS 0x00469760 /end MEASUREMENT
/begin MEASUREMENT model_ColumnSetup_00_B.Subtract2 "" FLOAT64_IEEE model_ColumnSetup_00_CM_double 0 0 -1.7E+308 1.7E+308 ECU_ADDRESS 0x00469768 /end MEASUREMENT
/begin MEASUREMENT model_ColumnSetup_00_B.Subtract4 "" FLOAT64_IEEE model_ColumnSetup_00_CM_double 0 0 -1.7E+308 1.7E+308 ECU_ADDRESS 0x00469770 /end MEASUREMENT
/begin MEASUREMENT model_ColumnSetup_00_B.Sum "" FLOAT64_IEEE model_ColumnSetup_00_CM_double 0 0 -1.7E+308 1.7E+308 ECU_ADDRESS 0x004697B0 /end MEASUREMENT
/begin MEASUREMENT model_ColumnSetup_00_B.Sum1 "" FLOAT64_IEEE model_ColumnSetup_00_CM_double 0 0 -1.7E+308 1.7E+308 ECU_ADDRESS 0x00469688 /end MEASUREMENT
/begin MEASUREMENT model_ColumnSetup_00_B.WhiteNoise "" FLOAT64_IEEE model_ColumnSetup_00_CM_double 0 0 -1.7E+308 1.7E+308 ECU_ADDRESS 0x00469630 /end MEASUREMENT
/begin MEASUREMENT model_ColumnSetup_00_B.ammms2 "" FLOAT64_IEEE model_ColumnSetup_00_CM_double 0 0 -1.7E+308 1.7E+308 ECU_ADDRESS 0x004697A0 /end MEASUREMENT
/begin MEASUREMENT model_ColumnSetup_00_B.dcmm "" FLOAT64_IEEE model_ColumnSetup_00_CM_double 0 0 -1.7E+308 1.7E+308 ECU_ADDRESS 0x00469670 /end MEASUREMENT
/begin MEASUREMENT model_ColumnSetup_00_B.dd "" FLOAT64_IEEE model_ColumnSetup_00_CM_double 0 0 -1.7E+308 1.7E+308 ECU_ADDRESS 0x00469668 /end MEASUREMENT
/begin MEASUREMENT model_ColumnSetup_00_B.dmmm "" FLOAT64_IEEE model_ColumnSetup_00_CM_double 0 0 -1.7E+308 1.7E+308 ECU_ADDRESS 0x00469780 /end MEASUREMENT
/begin MEASUREMENT model_ColumnSetup_00_B.fmN "" FLOAT64_IEEE model_ColumnSetup_00_CM_double 0 0 -1.7E+308 1.7E+308 ECU_ADDRESS 0x00469790 /end MEASUREMENT
/begin MEASUREMENT model_ColumnSetup_00_B.time_history "" FLOAT64_IEEE model_ColumnSetup_00_CM_double 0 0 -1.7E+308 1.7E+308 ECU_ADDRESS 0x00469620 /end MEASUREMENT
/begin MEASUREMENT model_ColumnSetup_00_B.u "" FLOAT64_IEEE model_ColumnSetup_00_CM_double 0 0 -1.7E+308 1.7E+308 ECU_ADDRESS 0x00469680 /end MEASUREMENT
/begin MEASUREMENT model_ColumnSetup_00_B.vcV "" FLOAT64_IEEE model_ColumnSetup_00_CM_double 0 0 -1.7E+308 1.7E+308 ECU_ADDRESS 0x00469690 /end MEASUREMENT
/begin MEASUREMENT model_ColumnSetup_00_DW.DigitalFilter_states "" FLOAT64_IEEE model_ColumnSetup_00_CM_double 0 0 -1.7E+308 1.7E+308 LAYOUT COLUMN_DIR MATRIX_DIM 130 ECU_ADDRESS 0x00469140 /end MEASUREMENT
/begin MEASUREMENT model_ColumnSetup_00_DW.NextOutput "" FLOAT64_IEEE model_ColumnSetup_00_CM_double 0 0 -1.7E+308 1.7E+308 ECU_ADDRESS 0x00469550 /end MEASUREMENT
/begin MEASUREMENT model_ColumnSetup_00_DW.RandSeed "" ULONG model_ColumnSetup_00_CM_uint32 0 0 0 2147483646 ECU_ADDRESS 0x004695F8 /end MEASUREMENT
/begin COMPU_METHOD model_ColumnSetup_00_CM_double "" IDENTICAL "%15.10" "" /end COMPU_METHOD
/begin COMPU_METHOD model_ColumnSetup_00_CM_uint32 "" IDENTICAL "%10.0" "" /end COMPU_METHOD
/begin RECORD_LAYOUT Scalar_FLOAT64_IEEE FNC_VALUES 1 FLOAT64_IEEE COLUMN_DIR DIRECT /end RECORD_LAYOUT
/begin RECORD_LAYOUT Scalar_ULONG FNC_VALUES 1 ULONG COLUMN_DIR DIRECT /end RECORD_LAYOUT
/begin GROUP model_ColumnSetup_00 "model_ColumnSetup_00" ROOT /end GROUP
/begin GROUP model_ColumnSetup_00_P.ch ""
 /begin REF_CHARACTERISTIC model_ColumnSetup_00_P.ch.am model_ColumnSetup_00_P.ch.dm model_ColumnSetup_00_P.ch.fm model_ColumnSetup_00_P.ch.dd /end REF_CHARACTERISTIC
/end GROUP
/end MODULE
/end PROJECT
